## sound/loongson/Kconfig
```kconfig
menuconfig LS_SND_HDA
	tristate "Loongson HD Audio"
	select SND_PCM
	select SND_VMASTER
	help
	  Say Y here to include support for "Loongson7A High Definition
	  Audio".

if LS_SND_HDA

config LS_HDA_POWER_SAVE
	bool "Aggressive power-saving on HD-audio"
	help
	  Say Y here to enable more aggressive power-saving mode on
	  HD-audio driver.  The power-saving timeout can be configured
	  via power_save option or over sysfs on-the-fly.

config LS_HDA_POWER_SAVE_DEFAULT
	int "Default time-out for HD-audio power-save mode"
    depends on LS7A_HDA_POWER_SAVE
	default 0
	  help
	  The default time-out value in seconds for HD-audio automatic
	  power-save mode.  0 means to disable the power-save mode.

endif
```
